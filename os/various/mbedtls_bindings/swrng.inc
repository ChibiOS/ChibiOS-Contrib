/*
    ChibiOS - Copyright (C) 2023 Xael South

    Licensed under the Apache License, Version 2.0 (the "License");
    you may not use this file except in compliance with the License.
    You may obtain a copy of the License at

        http://www.apache.org/licenses/LICENSE-2.0

    Unless required by applicable law or agreed to in writing, software
    distributed under the License is distributed on an "AS IS" BASIS,
    WITHOUT WARRANTIES OR CONDITIONS OF ANY KIND, either express or implied.
    See the License for the specific language governing permissions and
    limitations under the License.
*/

#include <stdint.h>
#include <stddef.h>

/* Python-generated as follows: for i in  [randint(0, 255) for _ in range(256)]: print("%#02x" % i, end=", ") */
static const uint8_t rnd[256] = {
    0xe4, 0xd9, 0x5b, 0xd1, 0x92, 0x23, 0x16, 0x55, 0x7e, 0x32, 0x67, 0xd9, 0x52, 0x97, 0x6b, 0xb4,
    0xb7, 0x44, 0xaa, 0x69, 0x85, 0x6b, 0xf6, 0x23, 0xcf, 0x2a, 0x91, 0x55, 0x57, 0x15, 0x6e, 0x29,
    0x62, 0x5f, 0x67, 0xa2, 0xe8, 0xa1, 0x76, 0x7e, 0x97, 0x0a, 0xf4, 0x12, 0x52, 0x82, 0x33, 0xe5,
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    0xf0, 0x93, 0x52, 0x13, 0x5f, 0x18, 0xca, 0x94, 0x9f, 0x9f, 0x7c, 0xbe, 0x29, 0x3e, 0xfa, 0xdd
};

int mbedtls_ctr_drbg_random(void *p_rng, unsigned char *output, size_t output_len) {

    (void)p_rng;

    while (output_len > 0) {
        const systime_t now = chVTGetSystemTime();

        const uint8_t n[sizeof(now)] = {
#if (CH_CFG_ST_RESOLUTION > 32)
            rnd[(now >> 56) & 0xFF], rnd[(now >> 48) & 0xFF],
            rnd[(now >> 40) & 0xFF], rnd[(now >> 32) & 0xFF],
            
#endif
#if (CH_CFG_ST_RESOLUTION > 16)
            rnd[(now >> 24) & 0xFF], rnd[(now >> 16) & 0xFF],
#endif
            rnd[(now >>  8) & 0xFF], rnd[(now >>  0) & 0xFF],
        };

        size_t i = sizeof(n)/sizeof(n[0]);
        while (i > 0 && output_len > 0) {
            output[--output_len] = n[--i];
        }
    }

    return 0;
}
