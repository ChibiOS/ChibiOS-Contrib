/*
    Copyright (C) 2020 Ein Terakawa
    Modifications copyright (C) 2026 Belonit

    Licensed under the Apache License, Version 2.0 (the "License");
    you may not use this file except in compliance with the License.
    You may obtain a copy of the License at

        http://www.apache.org/licenses/LICENSE-2.0

    Unless required by applicable law or agreed to in writing, software
    distributed under the License is distributed on an "AS IS" BASIS,
    WITHOUT WARRANTIES OR CONDITIONS OF ANY KIND, either express or implied.
    See the License for the specific language governing permissions and
    limitations under the License.
*/

#include "hal.h"
#if defined(I2C1_DISPLAY_LCD1602)
#include "lcd1602.h"
#endif
#include "ssd1306.h"

static const uint8_t logo_bits[] = {
    0x00, 0x00, 0x00, 0x80, 0xF0, 0xF8, 0xFC, 0xFC, 0xFE, 0x3E, 0x1E, 0x1E,
    0x7E, 0x7C, 0x7C, 0x78, 0x70, 0x40, 0x00, 0x00, 0xFE, 0xFE, 0xFE, 0xFE,
    0xFE, 0xE0, 0xE0, 0xE0, 0xE0, 0xE0, 0xC0, 0x00, 0x00, 0xEE, 0xEE, 0xEE,
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    0x7F, 0x7B, 0x7B, 0x79, 0x79, 0x78, 0x00, 0x00,
};

DEFINE_SSD1306_DRIVER(ssd1306_128x64, &I2CD0, 0x3CU, 128U, 64U, true);
#if defined(I2C1_DISPLAY_LCD1602)
static LCD1602Driver lcd1602 = {
    .i2cd = &I2CD1,
};
#else
DEFINE_SSD1306_DRIVER(ssd1306_128x32, &I2CD1, 0x3CU, 128U, 32U, true);
#endif

static void draw_logo(SSD1306_DRIVER *ssd1306, bool invert, uint8_t xx) {
  uint8_t width = ssd1306->width;
  uint8_t height = ssd1306->height;
  uint8_t num_pages = height / 8U;
  uint8_t invert_bits = invert ? 0xFFU : 0x00U;
  uint8_t *buf = SSD1306_GET_FRAMEBUFFER(ssd1306);

  for (uint8_t row = 0U; row < num_pages; ++row) {
    uint8_t row_offset = xx;

    if ((height == 64U) && (row >= (num_pages / 2U))) {
      row_offset += width / 4U;
    }

    for (uint8_t x = 0U; x < width; ++x) {
      uint8_t dat =
          logo_bits[(128U - row_offset + x) % 128U + (row % 4U) * width];

      if (((row / 2U) % 2U) == 0U) {
        dat ^= 0xFFU;
      }

      dat ^= invert_bits; /* Invert image bits.*/
      buf[row * width + x] = dat;
    }
  }
}

#if I2C_USE_MUTUAL_EXCLUSION
#define ACQUIRE_BUS(oled_driver) i2cAcquireBus((oled_driver)->i2cd)
#define RELEASE_BUS(oled_driver) i2cReleaseBus((oled_driver)->i2cd)
#else
#define ACQUIRE_BUS(oled_driver)
#define RELEASE_BUS(oled_driver)
#endif

#define I2C_CLK_FREQ 400000U
static const I2CConfig i2ccfg = {
    .clock = I2C_CLK_FREQ,
};

#if defined(I2C1_DISPLAY_LCD1602)
static const I2CConfig lcd1602_i2ccfg = {
    .clock = 100000U,
};
#endif

static THD_WORKING_AREA(waThread1, 128);
static THD_FUNCTION(Thread1, arg) {
  (void)arg;
  chRegSetThreadName("blinker");

  while (true) {
    palClearLine(LINE_LED);
    osalThreadSleepMilliseconds(100);
    palSetLine(LINE_LED);
    osalThreadSleepMilliseconds(400);
  }
}

#define I2C_THREAD_STACK_SIZE 256
static THD_WORKING_AREA(waThread2, I2C_THREAD_STACK_SIZE);
static THD_FUNCTION(Thread2, arg) {
  SSD1306_DRIVER *ssd1306 = (SSD1306_DRIVER *)arg;
  uint8_t x = 0U;

  chRegSetThreadName("oled1");
  ssd1306->i2ccfg = &i2ccfg;

  while (true) {
    if (!boardI2cRecover(ssd1306->i2cd)) {
      osalThreadSleepMilliseconds(100);
      continue;
    }

    ACQUIRE_BUS(ssd1306);
    bool ok = ssd1306_init(ssd1306);
    RELEASE_BUS(ssd1306);
    if (!ok) {
      osalThreadSleepMilliseconds(100);
      continue;
    }

    while (true) {
      osalThreadSleepMilliseconds(127);
      draw_logo(ssd1306, false, x);
      ACQUIRE_BUS(ssd1306);
      ok = ssd1306Update(ssd1306);
      RELEASE_BUS(ssd1306);
      if (!ok) {
        break;
      }
      x = (x + 1U) % 128U;
    }
  }
}

static THD_WORKING_AREA(waThread3, I2C_THREAD_STACK_SIZE);
static THD_FUNCTION(Thread3, arg) {
#if defined(I2C1_DISPLAY_LCD1602)
  LCD1602Driver *lcd = (LCD1602Driver *)arg;
  char counter[] = "I2C1 count 0000";
  uint16_t value = 0U;

  chRegSetThreadName("lcd1602");
  lcd->i2ccfg = &lcd1602_i2ccfg;

  while (true) {
    if (!boardI2cRecover(lcd->i2cd)) {
      osalThreadSleepMilliseconds(100);
      continue;
    }

    bool ok = lcd1602_init(lcd);
    if (!ok) {
      osalThreadSleepMilliseconds(100);
      continue;
    }

    while (true) {
      counter[11] = (char)('0' + (value / 1000U) % 10U);
      counter[12] = (char)('0' + (value / 100U) % 10U);
      counter[13] = (char)('0' + (value / 10U) % 10U);
      counter[14] = (char)('0' + value % 10U);
      ok = lcd1602_write_lines(lcd, "ChibiOS M252", counter);
      if (!ok) {
        break;
      }
      value = (value + 1U) % 10000U;
      osalThreadSleepMilliseconds(250);
    }
  }
#else
  SSD1306_DRIVER *ssd1306 = (SSD1306_DRIVER *)arg;
  uint8_t x = 0U;

  chRegSetThreadName("oled2");
  ssd1306->i2ccfg = &i2ccfg;

  while (true) {
    if (!boardI2cRecover(ssd1306->i2cd)) {
      osalThreadSleepMilliseconds(100);
      continue;
    }

    ACQUIRE_BUS(ssd1306);
    bool ok = ssd1306_init(ssd1306);
    RELEASE_BUS(ssd1306);
    if (!ok) {
      osalThreadSleepMilliseconds(100);
      continue;
    }

    while (true) {
      osalThreadSleepMilliseconds(131);
      draw_logo(ssd1306, true, x);
      ACQUIRE_BUS(ssd1306);
      ok = ssd1306Update(ssd1306);
      RELEASE_BUS(ssd1306);
      if (!ok) {
        break;
      }
      x = (x - 1U) % 128U;
    }
  }
#endif
}

int main(void) {
  halInit();
  chSysInit();

  chThdCreateStatic(waThread1, sizeof(waThread1), NORMALPRIO + 2, Thread1,
                    NULL);
  chThdCreateStatic(waThread2, sizeof(waThread2), NORMALPRIO + 1, Thread2,
                    &ssd1306_128x64);
  chThdCreateStatic(waThread3, sizeof(waThread3), NORMALPRIO + 1, Thread3,
#if defined(I2C1_DISPLAY_LCD1602)
                    &lcd1602);
#else
                    &ssd1306_128x32);
#endif

  while (true) {
    osalThreadSleepMilliseconds(500);
  }
}
